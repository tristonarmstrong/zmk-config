## config/boards/shields/custom_kb/Kconfig.defconfig
```kconfig
if SHIELD_CUSTOM_KB_LEFT

config ZMK_KEYBOARD_NAME
    default "Custom KB"

config ZMK_SPLIT_ROLE_CENTRAL
    default y

endif

if SHIELD_CUSTOM_KB_LEFT || SHIELD_CUSTOM_KB_RIGHT

config ZMK_SPLIT
    default y

endif
```
