## boards/shields/custom_kb/Kconfig.shield
```kconfig
# Copyright (c) 2020 Pete Johanson
# SPDX-License-Identifier: MIT

config SHIELD_CUSTOM_KB_LEFT
    def_bool $(shields_list_contains,custom_kb_left)

config SHIELD_CUSTOM_KB_RIGHT
    def_bool $(shields_list_contains,custom_kb_right)
```
